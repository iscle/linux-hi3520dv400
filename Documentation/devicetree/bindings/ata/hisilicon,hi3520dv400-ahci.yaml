## Documentation/devicetree/bindings/ata/hisilicon,hi3520dv400-ahci.yaml
```yaml
# SPDX-License-Identifier: (GPL-2.0-only OR BSD-2-Clause)
%YAML 1.2
---
$id: http://devicetree.org/schemas/ata/hisilicon,hi3520dv400-ahci.yaml#
$schema: http://devicetree.org/meta-schemas/core.yaml#

title: HiSilicon Hi3520DV400 AHCI controller

maintainers:
  - Iscle <albertiscle9@gmail.com>

allOf:
  - $ref: ahci-common.yaml#

properties:
  compatible:
    const: hisilicon,hi3520dv400-ahci
  reg:
    maxItems: 1
  interrupts:
    maxItems: 1
  hisilicon,crg:
    $ref: /schemas/types.yaml#/definitions/phandle
    description: Clock and reset controller containing SATA control registers.
  hisilicon,misc:
    $ref: /schemas/types.yaml#/definitions/phandle
    description: Miscellaneous system controller containing SATA PHY registers.
  hisilicon,ports:
    $ref: /schemas/types.yaml#/definitions/uint32
    enum: [1, 2]
    default: 1
    description: Number of contiguous SATA ports connected, starting at port zero.

required:
  - compatible
  - reg
  - interrupts
  - hisilicon,crg
  - hisilicon,misc

unevaluatedProperties: false
```

## Documentation/devicetree/bindings/clock/hisilicon,hi3520dv400-crg.yaml
```yaml
# SPDX-License-Identifier: (GPL-2.0-only OR BSD-2-Clause)
%YAML 1.2
---
$id: http://devicetree.org/schemas/clock/hisilicon,hi3520dv400-crg.yaml#
$schema: http://devicetree.org/meta-schemas/core.yaml#

title: HiSilicon Hi3520DV400 clock and reset controller

maintainers:
  - Iscle <albertiscle9@gmail.com>

properties:
  compatible:
    items:
      - const: hisilicon,hi3520dv400-crg
      - const: syscon
  reg:
    maxItems: 1
  '#clock-cells':
    const: 1
  '#reset-cells':
    const: 1

required:
  - compatible
  - reg
  - '#clock-cells'
  - '#reset-cells'

additionalProperties: false
```

## Documentation/devicetree/bindings/phy/hisilicon,hi3520dv400-usb2-phy.yaml
```yaml
# SPDX-License-Identifier: (GPL-2.0-only OR BSD-2-Clause)
%YAML 1.2
---
$id: http://devicetree.org/schemas/phy/hisilicon,hi3520dv400-usb2-phy.yaml#
$schema: http://devicetree.org/meta-schemas/core.yaml#

title: HiSilicon Hi3520DV400 shared USB 2.0 PHY

maintainers:
  - Iscle <albertiscle9@gmail.com>

description: |
  One PHY instance controls both host ports and is shared by the EHCI and
  OHCI controllers. The CRG and miscellaneous system controller supply
  the reset, clock and analog configuration registers.

properties:
  compatible:
    const: hisilicon,hi3520dv400-usb2-phy
  '#phy-cells':
    const: 0
  hisilicon,crg:
    $ref: /schemas/types.yaml#/definitions/phandle
    description: Clock and reset controller containing USB control registers.
  hisilicon,misc:
    $ref: /schemas/types.yaml#/definitions/phandle
    description: Miscellaneous system controller containing PHY analog registers.

required:
  - compatible
  - '#phy-cells'
  - hisilicon,crg
  - hisilicon,misc

additionalProperties: false
```

## Documentation/devicetree/bindings/soc/hisilicon/hisilicon,hi3520dv400-sysctrl.yaml
```yaml
# SPDX-License-Identifier: (GPL-2.0-only OR BSD-2-Clause)
%YAML 1.2
---
$id: http://devicetree.org/schemas/soc/hisilicon/hisilicon,hi3520dv400-sysctrl.yaml#
$schema: http://devicetree.org/meta-schemas/core.yaml#

title: HiSilicon Hi3520DV400 system controllers

maintainers:
  - Iscle <albertiscle9@gmail.com>

properties:
  compatible:
    items:
      - enum:
          - hisilicon,hi3520dv400-sysctrl
          - hisilicon,hi3520dv400-misc
      - const: syscon
  reg:
    maxItems: 1

required:
  - compatible
  - reg

additionalProperties: false
```

## Documentation/devicetree/bindings/timer/hisilicon,hi3520dv400-timer.yaml
```yaml
# SPDX-License-Identifier: (GPL-2.0-only OR BSD-2-Clause)
%YAML 1.2
---
$id: http://devicetree.org/schemas/timer/hisilicon,hi3520dv400-timer.yaml#
$schema: http://devicetree.org/meta-schemas/core.yaml#

title: HiSilicon Hi3520DV400 SP804 system timers

maintainers:
  - Iscle <albertiscle9@gmail.com>

description: |
  Three SP804 channels provide a free-running counter and separate clock events
  for CPU0 and CPU1. The counter and CPU0 event channels share one interrupt
  line; the free-running channel runs with its interrupt disabled. CPU1 uses
  the first channel of the next dual-timer block and a separate interrupt.

properties:
  compatible:
    const: hisilicon,hi3520dv400-timer
  reg:
    items:
      - description: Free-running clocksource channel
      - description: CPU0 clock event channel
      - description: CPU1 clock event channel
  reg-names:
    items:
      - const: clocksource
      - const: clockevent0
      - const: clockevent1
  interrupts:
    items:
      - description: CPU0 clock event
      - description: CPU1 clock event
  clocks:
    maxItems: 1

required:
  - compatible
  - reg
  - reg-names
  - interrupts
  - clocks

additionalProperties: false
```

## drivers/clk/hisilicon/Kconfig
```kconfig
# SPDX-License-Identifier: GPL-2.0-only
config COMMON_CLK_HI3516CV300
	tristate "HI3516CV300 Clock Driver"
	depends on ARCH_HISI || COMPILE_TEST
	select RESET_HISI
	default ARCH_HISI
	help
	  Build the clock driver for hi3516cv300.

config COMMON_CLK_HI3519
	tristate "Hi3519 Clock Driver"
	depends on ARCH_HISI || COMPILE_TEST
	select RESET_HISI
	default ARCH_HISI
	help
	  Build the clock driver for hi3519.

config COMMON_CLK_HI3520DV400
	tristate "HiSilicon Hi3520DV400 clock/reset controller"
	depends on ARCH_HISI || COMPILE_TEST
	select RESET_CONTROLLER
	help
	  Enable the Hi3520DV400 APB and UART clocks, Ethernet clock
	  gates and Ethernet reset controls. Clock and reset operations
	  serialize accesses to their shared control register.
	  To build this driver as a module, choose M here.

config COMMON_CLK_HI3559A
	bool "Hi3559A Clock Driver"
	depends on ARCH_HISI || COMPILE_TEST
	select RESET_HISI
	default ARCH_HISI
	help
	  Build the clock driver for hi3559a.

config COMMON_CLK_HI3660
	bool "Hi3660 Clock Driver"
	depends on ARCH_HISI || COMPILE_TEST
	default ARCH_HISI
	help
	  Build the clock driver for hi3660.

config COMMON_CLK_HI3670
	bool "Hi3670 Clock Driver"
	depends on ARCH_HISI || COMPILE_TEST
	default ARCH_HISI
	help
	  Build the clock driver for hi3670.

config COMMON_CLK_HI3798CV200
	tristate "Hi3798CV200 Clock Driver"
	depends on ARCH_HISI || COMPILE_TEST
	select RESET_HISI
	default ARCH_HISI
	help
	  Build the clock driver for hi3798cv200.

config COMMON_CLK_HI6220
	bool "Hi6220 Clock Driver"
	depends on ARCH_HISI || COMPILE_TEST
	default ARCH_HISI
	help
	  Build the Hisilicon Hi6220 clock driver based on the common clock framework.

config RESET_HISI
	bool "HiSilicon Reset Controller Driver"
	depends on ARCH_HISI || COMPILE_TEST
	select RESET_CONTROLLER
	help
	  Build reset controller driver for HiSilicon device chipsets.

config STUB_CLK_HI6220
	bool "Hi6220 Stub Clock Driver" if EXPERT
	depends on (COMMON_CLK_HI6220 || COMPILE_TEST)
	depends on MAILBOX
	default COMMON_CLK_HI6220
	help
	  Build the Hisilicon Hi6220 stub clock driver.

config STUB_CLK_HI3660
	bool "Hi3660 Stub Clock Driver" if EXPERT
	depends on (COMMON_CLK_HI3660 || COMPILE_TEST)
	depends on MAILBOX
	default COMMON_CLK_HI3660
	help
	  Build the Hisilicon Hi3660 stub clock driver.
```
